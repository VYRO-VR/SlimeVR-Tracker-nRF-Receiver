## boards/holyiot/holyiot_22046/Kconfig.holyiot_22046
```kconfig
# Copyright (c) 2018 Nordic Semiconductor ASA
# SPDX-License-Identifier: Apache-2.0

config BOARD_HOLYIOT_22046
	select SOC_NRF52840_QIAA

if BOARD_HOLYIOT_22046

config BOARD_HAS_NRF5_BOOTLOADER
	bool "Board has nRF5 bootloader"
	default y
	help
	  If selected, applications are linked so that they can be loaded by Nordic
	  nRF5 bootloader.

config BOARD_SERIAL_BACKEND_CDC_ACM
	bool "USB CDC"
	default y

config BOARD_ENABLE_DCDC
	bool "DCDC mode"
	select SOC_DCDC_NRF52X
	default n

endif # BOARD_HOLYIOT_22046
```

## boards/holyiot/holyiot_22046/board.yml
```yaml
# Copyright (c) 2024 Nordic Semiconductor ASA
# SPDX-License-Identifier: Apache-2.0

board:
  name: holyiot_22046
  full_name: holyiot_22046
  vendor: holyiot
  socs:
  - name: nrf52840
```

## boards/holyiot/holyiot_22046/holyiot_22046_defconfig
```kconfig
# Copyright (c) 2024 Nordic Semiconductor ASA
# SPDX-License-Identifier: Apache-2.0

CONFIG_ARM_MPU=y
CONFIG_HW_STACK_PROTECTION=y
CONFIG_GPIO=y

CONFIG_SLIMEVR_USB_DEVICE_MANUFACTURER="Holyiot"
CONFIG_SLIMEVR_USB_DEVICE_PRODUCT="SlimeNRF Receiver Holyiot-22046"

CONFIG_LED_RGB_COLOR=y

CONFIG_USE_SEGGER_RTT=y
CONFIG_RTT_CONSOLE=y
CONFIG_LOG_BACKEND_RTT=y
```

## boards/mocha-elec/mochi/mochi_uf2_defconfig
```kconfig
# Copyright (c) 2024 Nordic Semiconductor ASA
# SPDX-License-Identifier: Apache-2.0

CONFIG_ARM_MPU=y
CONFIG_HW_STACK_PROTECTION=y
CONFIG_GPIO=y

CONFIG_LED_RGB_COLOR=y

CONFIG_SLIMEVR_USB_DEVICE_MANUFACTURER="Mocha-Elec"
CONFIG_SLIMEVR_USB_DEVICE_PRODUCT="Mochi Receiver"

CONFIG_USE_SEGGER_RTT=y
CONFIG_RTT_CONSOLE=y
CONFIG_LOG_BACKEND_RTT=y

#generate for adafruit uf2 bootloader flashing
CONFIG_BUILD_OUTPUT_UF2=y
CONFIG_BUILD_OUTPUT_UF2_FAMILY_ID="0x621e937a"
CONFIG_FLASH_LOAD_OFFSET=0x1000
# no FEM on the Mochi: bare nRF52833 radio caps out at +8 dBm
CONFIG_RADIO_TX_POWER=8
```
